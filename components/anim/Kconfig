## components/anim/Kconfig
```kconfig
# Animation configuration (currently empty)
menu "Animation"
    # Placeholder for future animation configuration
endmenu
```

## components/audio/Kconfig
```kconfig
menu "Audio Configuration"

    config AUDIO_BUZZER_GPIO
        int "Buzzer GPIO pin"
        default 41
        range 0 48
        help
            GPIO pin connected to the buzzer/speaker.
            Default is GPIO 41 for ESP32-P4.

    config AUDIO_ENABLED_DEFAULT
        bool "Enable audio by default"
        default y
        help
            Whether audio should be enabled at startup.

    config AUDIO_DEFAULT_VOLUME
        int "Default volume (0-100)"
        default 50
        range 0 100
        help
            Default audio volume at startup.

endmenu
```

## components/game/Kconfig
```kconfig
menu "Game Tuning"

config GAME_TICK_MS
    int "Intervalle de mise à jour de la logique de jeu (ms)"
    default 1000
    range 100 5000
    help
        Temps en millisecondes entre deux mises à jour de la logique de
        simulation.  Diminuez cette valeur pour une simulation plus
        rapide ou augmentez‑la pour réduire la charge CPU.

endmenu
```

## components/input/Kconfig
```kconfig
menu "Touch (GT911) Configuration"

config TOUCH_I2C_PORT
    int "Numéro du port I2C du tactile"
    default 0
    help
        Numéro du contrôleur I2C utilisé pour le pavé tactile GT911.

config TOUCH_SDA_GPIO
    int "GPIO SDA du GT911"
    default 10
    help
        Broche SDA utilisée pour le bus I2C du contrôleur tactile.

config TOUCH_SCL_GPIO
    int "GPIO SCL du GT911"
    default 11
    help
        Broche SCL utilisée pour le bus I2C du contrôleur tactile.

config TOUCH_INT_GPIO
    int "GPIO INT# du GT911"
    default 12
    help
        Broche d’interruption du contrôleur tactile.  Cette broche peut
        être laissée non connectée si l’on utilise la méthode de
        sondage (polling).

config TOUCH_RST_GPIO
    int "GPIO RESET du GT911"
    default 13
    help
        Broche de reset matériel du contrôleur tactile.  Elle est
        utilisée pour mettre le GT911 dans son état initial au boot.

endmenu
```

## components/sim_display/Kconfig
```kconfig
menu "Display Configuration"

config LCD_RESET_GPIO
    int "GPIO pour RESET de l'écran (JD9165)"
    default 38
    help
        Numéro de GPIO utilisé pour contrôler la broche RESET du
        panneau LCD JD9165.  Ce signal remet le contrôleur LCD à
        l'état initial lors de l'initialisation.

config LCD_BL_PWM_GPIO
    int "GPIO pour contrôle du rétroéclairage (PWM backlight)"
    default 39
    help
        Numéro de GPIO utilisé pour contrôler la LED de
        rétroéclairage.  Vous pouvez connecter ce signal à un
        périphérique LEDC pour moduler la luminosité par PWM.  Par
        défaut, le rétroéclairage est simplement activé en mode
        binaire.

endmenu
```

## components/storage/Kconfig
```kconfig
menu "Storage (legacy)"
    # Configuration for using the SD card is now defined in
    # main/Kconfig.projbuild.  This Kconfig intentionally does not
    # define any symbols to avoid duplicate definitions.
endmenu
```

## firmware/controller/main/Kconfig.projbuild
```kconfig
menu "Dome bus configuration"

config DOME_BUS_MUTEX_TIMEOUT_MS
    int "Dome bus mutex timeout (ms)"
    range 0 10000
    default 50
    help
        Timeout in milliseconds for dome bus mutex acquisition. When set to 0 the
        lock will wait indefinitely. A non-zero value causes dome_bus_lock() and
        the read/write helpers to return ESP_ERR_TIMEOUT if the mutex cannot be
        taken within the configured interval.

endmenu
```

## firmware/controller/sdkconfig.defaults
```kconfig
# Flash / PSRAM OPI Octal @ 80 MHz
CONFIG_ESPTOOLPY_FLASHSIZE_32MB=y
CONFIG_ESPTOOLPY_FLASHMODE_OPI=y
CONFIG_ESPTOOLPY_FLASHFREQ_80M=y
CONFIG_SPIRAM=y
CONFIG_SPIRAM_MODE_OCT=y
CONFIG_SPIRAM_TYPE_OPI=y
CONFIG_SPIRAM_SPEED_80M=y
# USB CDC console
CONFIG_ESP_CONSOLE_USB_CDC=y
CONFIG_TINYUSB_CDC_ENABLED=y
# Dual OTA
CONFIG_PARTITION_TABLE_TWO_OTA=y
CONFIG_BOOTLOADER_APP_ROLLBACK_ENABLE=y
# OTA signature verification
CONFIG_TRIBO_OTA_PUBKEY_BASE64="BwfSzErF6+bjU+JAcL/uyPFLuVvQIIlJS8IMLiR5aEA="
# Networking essentials
CONFIG_LWIP_LOCAL_HOSTNAME="terrarium-s3"
CONFIG_ESP_HTTPS_SERVER_ENABLE=y
CONFIG_ESP_TLS_CLIENT_SESSION_TICKETS=y
CONFIG_NVS_ENCRYPTION=y
CONFIG_NVS_ENCRYPTION_PARTITION="nvs_keys"
# Dome bus concurrency
CONFIG_DOME_BUS_MUTEX_TIMEOUT_MS=50
```

## firmware/dome/sdkconfig.defaults
```kconfig
# Flash / PSRAM OPI Octal @ 80 MHz
CONFIG_ESPTOOLPY_FLASHSIZE_32MB=y
CONFIG_ESPTOOLPY_FLASHMODE_OPI=y
CONFIG_ESPTOOLPY_FLASHFREQ_80M=y
CONFIG_SPIRAM=y
CONFIG_SPIRAM_MODE_OCT=y
CONFIG_SPIRAM_TYPE_OPI=y
CONFIG_SPIRAM_SPEED_80M=y
# USB CDC console
CONFIG_ESP_CONSOLE_USB_CDC=y
CONFIG_TINYUSB_CDC_ENABLED=y
# Dual OTA
CONFIG_PARTITION_TABLE_TWO_OTA=y
CONFIG_BOOTLOADER_APP_ROLLBACK_ENABLE=y
# OTA signature verification
CONFIG_TRIBO_OTA_PUBKEY_BASE64="BwfSzErF6+bjU+JAcL/uyPFLuVvQIIlJS8IMLiR5aEA="
# Networking essentials
CONFIG_LWIP_LOCAL_HOSTNAME="terrarium-s3"
```

## firmware/panel/sdkconfig.defaults
```kconfig
CONFIG_IDF_TARGET="esp32s3"
CONFIG_ESPTOOLPY_FLASHMODE_QIO=y
CONFIG_ESPTOOLPY_FLASHFREQ_80M=y
CONFIG_SPIRAM=y
CONFIG_SPIRAM_MODE_OCT=y
CONFIG_SPIRAM_SPEED_80M=y
CONFIG_SPIRAM_SIZE=8388608
CONFIG_SPIRAM_BOOT_INIT=y
CONFIG_SPIRAM_ALLOW_STACK_EXTERNAL_MEMORY=y
CONFIG_SPIRAM_MALLOC_ALWAYSINTERNAL=32768
CONFIG_SPIRAM_MALLOC_RESERVE_INTERNAL=32768
CONFIG_ESP_CONSOLE_USB_CDC=y
CONFIG_ESP_CONSOLE_SECONDARY_NONE=y
CONFIG_PARTITION_TABLE_CUSTOM=y
CONFIG_PARTITION_TABLE_CUSTOM_FILENAME="partitions.csv"
CONFIG_PARTITION_TABLE_FILENAME="partitions.csv"
CONFIG_PARTITION_TABLE_TWO_OTA=y
CONFIG_FREERTOS_HZ=1000
CONFIG_LVGL_VERSION_9=y
CONFIG_LV_USE_LOG=y
CONFIG_LV_USE_PERF_MONITOR=y
CONFIG_LV_USE_MEM_MONITOR=y
CONFIG_LV_MEM_CUSTOM=y
CONFIG_LV_MEM_CUSTOM_INCLUDE="drivers/lvgl_port.h"
CONFIG_LV_MEM_CUSTOM_ALLOC=1
CONFIG_LV_MEM_CUSTOM_FREE=1
CONFIG_LV_USE_FS_IF=y
CONFIG_LV_USE_PNG=y
CONFIG_LV_USE_JPEG_TJ=y
CONFIG_LV_COLOR_DEPTH_16=y
CONFIG_LV_COLOR_16_SWAP=y
CONFIG_LV_SPRINTF_USE_FLOAT=y
CONFIG_ESP_HTTP_CLIENT_ENABLE_HTTPS=y
CONFIG_ESP_HTTP_CLIENT_AUTO_REDIRECT=y
CONFIG_ESP_WIFI_STA_DISCONNECTED_PM_ENABLE=y
CONFIG_ESP_WIFI_ENABLE_WPA3_SAE=y
CONFIG_ESP_WIFI_ENABLE_WPA3_OWE_STA=y
CONFIG_ESP_WIFI_STATIC_RX_BUFFER_NUM=12
CONFIG_ESP_WIFI_DYNAMIC_RX_BUFFER_NUM=32
CONFIG_ESP_WIFI_NVS_ENABLED=y
CONFIG_ESP_WIFI_SOFTAP_SUPPORT=0
CONFIG_PM_ENABLE=y
CONFIG_ESP_MAIN_TASK_STACK_SIZE=12288
CONFIG_ESP_TASK_WDT=n
CONFIG_ESP_SYSTEM_PANIC_PRINT_HALT=y
CONFIG_NEWLIB_NANO_FORMAT=y
CONFIG_COMPILER_OPTIMIZATION_SIZE=y
CONFIG_NVS_ENCRYPTION=y
CONFIG_NVS_SEC_KEY_PARTITION=y
CONFIG_NVS_SEC_KEY_PARTITION_NAME="nvs_keys"
CONFIG_NVS_SEC_KEY_PARTITION_SIZE=0x2000
CONFIG_NVS_SEC_KEY_PROTECTION_SCHEME_FLASH=y
CONFIG_LWIP_DHCP_TIMEOUT=60000
CONFIG_LWIP_MAX_SOCKETS=16
CONFIG_MBEDTLS_DYNAMIC_BUFFER=y
CONFIG_MBEDTLS_DYNAMIC_FREE_PEER_CERT=y
CONFIG_HTTP_CLIENT_ENABLE_HTTPS=y
CONFIG_ESP_NETIF_TCPIP_ADAPTER_COMPATIBLE_LAYER=y
CONFIG_ESP_TLS_USE_DS_PERIPHERAL=y
CONFIG_ESP_TLS_CLIENT_SESSION_TICKETS=y
CONFIG_LOG_BOOTLOADER_LEVEL_INFO=y
CONFIG_BOOTLOADER_VDDSDIO_BOOST_1_9V=y
CONFIG_BOOTLOADER_SKIP_VALIDATE_IN_DEEP_SLEEP=y
```

## main/Kconfig.projbuild
```kconfig
menu "Application Configuration"

    menu "LCD Display Settings"
        config APP_DISPLAY_SELF_TEST
            bool "Draw boot test pattern"
            default y
            help
                Draw a simple RGB test pattern at boot to validate panel data path
                before LVGL starts. Disable once the display is confirmed.

        config APP_LCD_H_RES
            int "LCD horizontal resolution"
            default 1024
            help
                Horizontal resolution of the LCD panel in pixels.

        config APP_LCD_V_RES
            int "LCD vertical resolution"
            default 600
            help
                Vertical resolution of the LCD panel in pixels (7-inch panel).

        choice APP_LCD_ORIENTATION
            prompt "LCD orientation"
            default APP_LCD_ORIENTATION_LANDSCAPE
            help
                Select the display orientation (7-inch panel is landscape).

            config APP_LCD_ORIENTATION_PORTRAIT
                bool "Portrait (600x1024)"

            config APP_LCD_ORIENTATION_LANDSCAPE
                bool "Landscape (1024x600)"
        endchoice

        config APP_LVGL_ROTATION
            int "LVGL software rotation (0, 90, 180, 270)"
            default 0
            range 0 270
            help
                LVGL software rotation angle in degrees.

        choice APP_LCD_ROTATION
            prompt "LCD rotation"
            default APP_LCD_ROTATION_0

            config APP_LCD_ROTATION_0
                bool "0°"

            config APP_LCD_ROTATION_90
                bool "90°"

            config APP_LCD_ROTATION_180
                bool "180°"

            config APP_LCD_ROTATION_270
                bool "270°"
        endchoice

        config APP_LCD_HSYNC
            int "HSYNC pulse width"
            default 24

        config APP_LCD_HBP
            int "Horizontal back porch"
            default 136

        config APP_LCD_HFP
            int "Horizontal front porch"
            default 160

        config APP_LCD_VSYNC
            int "VSYNC pulse width"
            default 2

        config APP_LCD_VBP
            int "Vertical back porch"
            default 21

        config APP_LCD_VFP
            int "Vertical front porch"
            default 12

        config APP_LCD_PCLK
            int "Pixel clock (Hz)"
            default 51200000

        choice APP_LCD_RGB_ORDER
            prompt "RGB color order"
            default APP_LCD_RGB_ORDER_RGB

            config APP_LCD_RGB_ORDER_RGB
                bool "RGB"

            config APP_LCD_RGB_ORDER_BGR
                bool "BGR"
        endchoice
    endmenu

    menu "MIPI-DSI Settings"
        config APP_DSI_LANE_NUM
            int "MIPI-DSI lane number"
            default 2
            range 1 4
            help
                Number of MIPI-DSI data lanes.

        config APP_DSI_LANE_BITRATE_MBPS
            int "MIPI-DSI lane bit rate (Mbps)"
            default 800
            help
                Bit rate per lane in Mbps.
    endmenu

    menu "Touch Controller Settings (GT911)"
        config APP_TOUCH_I2C_PORT
            int "I2C port number for touch"
            default 0
            range 0 1
            help
                I2C port number used for the touch controller.

        config APP_TOUCH_I2C_SDA
            int "Touch I2C SDA GPIO"
            default 22
            help
                GPIO number for I2C SDA signal.

        config APP_TOUCH_I2C_SCL
            int "Touch I2C SCL GPIO"
            default 23
            help
                GPIO number for I2C SCL signal.

        config APP_TOUCH_I2C_ADDR
            hex "Touch controller I2C address"
            default 0x5D
            help
                I2C address of the GT911 touch controller.
                0x5D (default) or 0x14.

        config APP_TOUCH_I2C_INT_GPIO
            int "Touch interrupt GPIO"
            default 20
            help
                GPIO number for touch interrupt signal.

        config APP_TOUCH_I2C_RST_GPIO
            int "Touch reset GPIO"
            default 21
            help
                GPIO number for touch reset signal.

        config APP_TOUCH_SWAP_XY
            bool "Touch swap XY"
            default n

        config APP_TOUCH_MIRROR_X
            bool "Touch mirror X"
            default n

        config APP_TOUCH_INVERT_Y
            bool "Touch invert Y"
            default n
    endmenu

    menu "LVGL Task Settings"
        config APP_LVGL_TASK_STACK_SIZE
            int "LVGL task stack size"
            default 8192

        config APP_LVGL_TASK_PRIORITY
            int "LVGL task priority"
            default 5
    endmenu

    menu "Log Settings"
        choice APP_LOG_DEFAULT_LEVEL
            prompt "Default log level"
            default APP_LOG_DEFAULT_LEVEL_INFO

            config APP_LOG_DEFAULT_LEVEL_DEBUG
                bool "Debug"

            config APP_LOG_DEFAULT_LEVEL_INFO
                bool "Info"

            config APP_LOG_DEFAULT_LEVEL_WARN
                bool "Warn"

            config APP_LOG_DEFAULT_LEVEL_ERROR
                bool "Error"
        endchoice
    endmenu

endmenu
```

## sdkconfig.defaults
```kconfig
# Reptile Sim Ultimate - SDK Config Defaults

# Target
CONFIG_IDF_TARGET="esp32p4"

# Chip revision (ESP32-P4 rev < 3.0 support)
CONFIG_ESP32P4_SELECTS_REV_LESS_V3=y
CONFIG_ESP32P4_REV_MIN_FULL=100
CONFIG_ESP_REV_MIN_FULL=100
CONFIG_ESP32P4_REV_MAX_FULL=199
CONFIG_ESP_REV_MAX_FULL=199

# CPU frequency (safer for rev < 3.0)
CONFIG_ESP_DEFAULT_CPU_FREQ_MHZ_360=y
CONFIG_ESP_DEFAULT_CPU_FREQ_MHZ=360

# Compiler optimizations
CONFIG_COMPILER_OPTIMIZATION_SIZE=y
CONFIG_COMPILER_CXX_EXCEPTIONS=y
CONFIG_COMPILER_CXX_RTTI=y

# PSRAM
CONFIG_SPIRAM=y
CONFIG_SPIRAM_SPEED_200M=y

# FreeRTOS
CONFIG_FREERTOS_HZ=1000
CONFIG_FREERTOS_UNICORE=n

# LVGL Configuration
CONFIG_LV_COLOR_DEPTH_16=y
CONFIG_LV_FONT_MONTSERRAT_18=y
CONFIG_LV_FONT_MONTSERRAT_20=y
CONFIG_LV_FONT_MONTSERRAT_24=y

# LCD Configuration
CONFIG_LCD_RGB_ISR_IRAM_SAFE=y

# Application
CONFIG_APP_DISPLAY_SELF_TEST=y

# Logging
CONFIG_LOG_DEFAULT_LEVEL_INFO=y
CONFIG_LOG_MAXIMUM_LEVEL_VERBOSE=y
```
